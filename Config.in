## Config.in
```kconfig
# Include all package configuration snippets from the overlay.
source "$BR2_EXTERNAL_WPE_PATH/package/cog/Config.in"
source "$BR2_EXTERNAL_WPE_PATH/package/eglinfo/Config.in"
source "$BR2_EXTERNAL_WPE_PATH/package/libwpe/Config.in"
source "$BR2_EXTERNAL_WPE_PATH/package/wpebackend-fdo/Config.in"
source "$BR2_EXTERNAL_WPE_PATH/package/wpebackend-rdk/Config.in"
source "$BR2_EXTERNAL_WPE_PATH/package/wpewebkit/Config.in"
```

## configs/raspberrypi2_wpe_defconfig
```kconfig
BR2_arm=y
BR2_cortex_a7=y
BR2_ARM_FPU_NEON_VFPV4=y
BR2_ARM_INSTRUCTIONS_THUMB2=y
BR2_CCACHE=y
BR2_CCACHE_DIR="$(TOPDIR)/ccache/buildroot-ccache-$(BR2_ARCH)"
BR2_TOOLCHAIN_BUILDROOT_GLIBC=y
BR2_PACKAGE_HOST_LINUX_HEADERS_CUSTOM_4_9=y
BR2_TOOLCHAIN_BUILDROOT_CXX=y
BR2_GCC_ENABLE_GRAPHITE=y
BR2_PACKAGE_HOST_GDB=y
BR2_PACKAGE_HOST_GDB_TUI=y
BR2_ROOTFS_DEVICE_CREATION_DYNAMIC_EUDEV=y
BR2_TARGET_GENERIC_ROOT_PASSWD="root"
BR2_SYSTEM_DHCP="eth0"
BR2_ROOTFS_POST_BUILD_SCRIPT="board/raspberrypi2/post-build.sh"
BR2_ROOTFS_POST_IMAGE_SCRIPT="board/raspberrypi2/post-image.sh"
BR2_LINUX_KERNEL=y
BR2_LINUX_KERNEL_CUSTOM_GIT=y
BR2_LINUX_KERNEL_CUSTOM_REPO_URL="https://github.com/raspberrypi/linux.git"
BR2_LINUX_KERNEL_CUSTOM_REPO_VERSION="9126e25b0934bd7bd843763310ea4b34c6e139d0"
BR2_LINUX_KERNEL_DEFCONFIG="bcm2709"
BR2_LINUX_KERNEL_DTS_SUPPORT=y
BR2_LINUX_KERNEL_INTREE_DTS_NAME="bcm2709-rpi-2-b"
BR2_PACKAGE_GDB=y
BR2_PACKAGE_GDB_SERVER=y
BR2_PACKAGE_GDB_DEBUGGER=y
BR2_PACKAGE_GDB_TUI=y
BR2_PACKAGE_STRACE=y
BR2_PACKAGE_BITSTREAM_VERA=y
BR2_PACKAGE_MESA3D=y
BR2_PACKAGE_MESA3D_GALLIUM_DRIVER_VC4=y
BR2_PACKAGE_MESA3D_OPENGL_ES=y
BR2_PACKAGE_RPI_FIRMWARE=y
BR2_PACKAGE_DROPBEAR=y
BR2_PACKAGE_NTP=y
BR2_PACKAGE_NTP_NTPDATE=y
BR2_TARGET_ROOTFS_EXT2=y
BR2_TARGET_ROOTFS_EXT2_4=y
BR2_TARGET_ROOTFS_EXT2_SIZE="1G"
# BR2_TARGET_ROOTFS_TAR is not set
BR2_PACKAGE_HOST_DOSFSTOOLS=y
BR2_PACKAGE_HOST_GENIMAGE=y
BR2_PACKAGE_HOST_MTOOLS=y
BR2_PACKAGE_COG=y
BR2_PACKAGE_COG_PLATFORM_FDO=y
BR2_PACKAGE_COG_PROGRAMS=y
BR2_PACKAGE_COG_PROGRAMS_DBUS_SYSTEM_BUS=y
BR2_PACKAGE_COG_PROGRAMS_HOME_URI="https://wpewebkit.org"
BR2_PACKAGE_EGLINFO=y
BR2_PACKAGE_WPEWEBKIT=y
BR2_PACKAGE_WPEWEBKIT_BUILD_JSC=y
BR2_PACKAGE_WPEWEBKIT_MULTIMEDIA=y
```

## configs/raspberrypi3_64_wpe_defconfig
```kconfig
BR2_aarch64=y
BR2_ARM_FPU_VFPV4=y
BR2_CCACHE=y
BR2_CCACHE_DIR="(TOPDIR)/ccache/buildroot-ccache-$(BR2_ARCH)"
BR2_GLOBAL_PATCH_DIR="$(BR2_EXTERNAL_WPE_RPI_PATH)/patches"
BR2_SSP_STRONG=y
BR2_RELRO_PARTIAL=y
BR2_FORTIFY_SOURCE_2=y
BR2_TOOLCHAIN_BUILDROOT_GLIBC=y
BR2_PACKAGE_HOST_LINUX_HEADERS_CUSTOM_4_9=y
BR2_TOOLCHAIN_BUILDROOT_CXX=y
BR2_GCC_ENABLE_LTO=y
BR2_INIT_SYSTEMD=y
BR2_TARGET_GENERIC_ROOT_PASSWD="wperocks"
BR2_SYSTEM_DHCP="eth0"
BR2_ROOTFS_POST_BUILD_SCRIPT="board/raspberrypi3-64/post-build.sh"
BR2_ROOTFS_POST_IMAGE_SCRIPT="board/raspberrypi3-64/post-image.sh"
BR2_ROOTFS_POST_SCRIPT_ARGS="--aarch64"
BR2_LINUX_KERNEL=y
BR2_LINUX_KERNEL_CUSTOM_GIT=y
BR2_LINUX_KERNEL_CUSTOM_REPO_URL="https://github.com/raspberrypi/linux.git"
BR2_LINUX_KERNEL_CUSTOM_REPO_VERSION="33ee56d5927ceff630fbc87e3f5caa409b6ae114"
BR2_LINUX_KERNEL_DEFCONFIG="bcmrpi3"
BR2_LINUX_KERNEL_DTS_SUPPORT=y
BR2_LINUX_KERNEL_INTREE_DTS_NAME="broadcom/bcm2710-rpi-3-b broadcom/bcm2837-rpi-3-b"
BR2_PACKAGE_MESA3D=y
BR2_PACKAGE_MESA3D_GALLIUM_DRIVER_VC4=y
BR2_PACKAGE_MESA3D_OSMESA=y
BR2_PACKAGE_MESA3D_OPENGL_ES=y
BR2_PACKAGE_WESTON_DRM=y
BR2_PACKAGE_WESTON_FBDEV=y
BR2_PACKAGE_RPI_FIRMWARE=y
# BR2_PACKAGE_RPI_FIRMWARE_INSTALL_DTB_OVERLAYS is not set
BR2_TARGET_ROOTFS_EXT2=y
BR2_TARGET_ROOTFS_EXT2_4=y
BR2_TARGET_ROOTFS_EXT2_SIZE="250M"
# BR2_TARGET_ROOTFS_TAR is not set
BR2_PACKAGE_HOST_DOSFSTOOLS=y
BR2_PACKAGE_HOST_GENIMAGE=y
BR2_PACKAGE_HOST_MTOOLS=y
BR2_PACKAGE_COG=y
BR2_PACKAGE_COG_PLATFORM_FDO=y
BR2_PACKAGE_WPEBACKEND_FDO=y
BR2_PACKAGE_WPEWEBKIT=y
```

## configs/raspberrypi3_wpe_rdk_defconfig
```kconfig
BR2_arm=y
BR2_cortex_a53=y
BR2_ARM_FPU_NEON_VFPV4=y
BR2_ARM_INSTRUCTIONS_THUMB2=y
BR2_CCACHE=y
BR2_CCACHE_DIR="$(TOPDIR)/ccache/buildroot-ccache-$(BR2_ARCH)"
BR2_GLOBAL_PATCH_DIR="$(BR2_EXTERNAL_WPE_PATH)/patches"
BR2_TOOLCHAIN_BUILDROOT_GLIBC=y
BR2_PACKAGE_HOST_LINUX_HEADERS_CUSTOM_4_14=y
BR2_TOOLCHAIN_BUILDROOT_CXX=y
BR2_GCC_ENABLE_GRAPHITE=y
BR2_PACKAGE_HOST_GDB=y
BR2_PACKAGE_HOST_GDB_TUI=y
BR2_ROOTFS_DEVICE_CREATION_DYNAMIC_EUDEV=y
BR2_TARGET_GENERIC_ROOT_PASSWD="root"
BR2_SYSTEM_DHCP="eth0"
BR2_ROOTFS_POST_BUILD_SCRIPT="board/raspberrypi3/post-build.sh"
BR2_ROOTFS_POST_IMAGE_SCRIPT="board/raspberrypi3/post-image.sh"
BR2_ROOTFS_POST_SCRIPT_ARGS="--add-pi3-miniuart-bt-overlay"
BR2_LINUX_KERNEL=y
BR2_LINUX_KERNEL_CUSTOM_TARBALL=y
BR2_LINUX_KERNEL_CUSTOM_TARBALL_LOCATION="$(call github,raspberrypi,linux,865ddc1393f558198e7e7ce70928ff2e49c4f7f6)/linux-865ddc1393f558198e7e7ce70928ff2e49c4f7f6.tar.gz"
BR2_LINUX_KERNEL_DEFCONFIG="bcm2709"
BR2_LINUX_KERNEL_DTS_SUPPORT=y
BR2_LINUX_KERNEL_INTREE_DTS_NAME="bcm2710-rpi-3-b bcm2710-rpi-3-b-plus bcm2710-rpi-cm3"
BR2_PACKAGE_CONNMAN=y
BR2_PACKAGE_CONNMAN_WIFI=y
BR2_PACKAGE_CONNMAN_CLIENT=y
BR2_PACKAGE_GDB=y
BR2_PACKAGE_GDB_SERVER=y
BR2_PACKAGE_GDB_DEBUGGER=y
BR2_PACKAGE_GDB_TUI=y
BR2_PACKAGE_STRACE=y
BR2_PACKAGE_BITSTREAM_VERA=y
BR2_PACKAGE_RPI_USERLAND=y
BR2_PACKAGE_RPI_USERLAND_START_VCFILED=y
BR2_PACKAGE_RPI_FIRMWARE=y
BR2_PACKAGE_RPI_WIFI_FIRMWARE=y
BR2_PACKAGE_DROPBEAR=y
BR2_PACKAGE_NTP=y
BR2_PACKAGE_NTP_NTPDATE=y
BR2_TARGET_ROOTFS_EXT2=y
BR2_TARGET_ROOTFS_EXT2_4=y
BR2_TARGET_ROOTFS_EXT2_SIZE="512M"
# BR2_TARGET_ROOTFS_TAR is not set
BR2_PACKAGE_HOST_DOSFSTOOLS=y
BR2_PACKAGE_HOST_GENIMAGE=y
BR2_PACKAGE_HOST_MTOOLS=y
BR2_PACKAGE_COG=y
BR2_PACKAGE_COG_PROGRAMS=y
BR2_PACKAGE_COG_PROGRAMS_DBUS_SYSTEM_BUS=y
BR2_PACKAGE_COG_PROGRAMS_HOME_URI="https://wpewebkit.org"
BR2_PACKAGE_EGLINFO=y
BR2_PACKAGE_WPEBACKEND_RDK=y
BR2_PACKAGE_WPEWEBKIT=y
BR2_PACKAGE_WPEWEBKIT_BUILD_JSC=y
BR2_PACKAGE_WPEWEBKIT_MINIBROWSER=y
BR2_PACKAGE_WPEWEBKIT_MULTIMEDIA=y
BR2_PACKAGE_GST_OMX=y
```

## package/cog/Config.in
```kconfig
config BR2_PACKAGE_COG
	bool "cog"
	depends on BR2_PACKAGE_WPEWEBKIT
	help
	  Single “window” launcher for the WebKit WPE port, and
	  helper library for implementing WPE launcher. It does
	  not provide any chrome, and is suitable to be used
	  as a Web application container.

if BR2_PACKAGE_COG

config BR2_PACKAGE_COG_PLATFORM_FDO_ARCH_SUPPORTS
	bool
	default y
	depends on BR2_PACKAGE_HAS_LIBEGL_WAYLAND
	depends on BR2_PACKAGE_HAS_LIBGLES
	depends on BR2_PACKAGE_WPEBACKEND_FDO

comment "cog fdo platform plugin requires egl, gles, wayland"
	depends on !BR2_PACKAGE_COG_PLATFORM_FDO_ARCH_SUPPORTS

config BR2_PACKAGE_COG_PLATFORM_FDO
	bool "fdo platform"
	depends on BR2_PACKAGE_COG_PLATFORM_FDO_ARCH_SUPPORTS
	help
	  Support platform plug-in which uses FreeDesktop.Org's
	  technologies for windowing. Choose this to support output
	  to Wayland compositor.

config BR2_PACKAGE_COG_PROGRAMS
	bool "build and install programs"
	help
	  Build and install the "cog" and "cogctl" programs.

if BR2_PACKAGE_COG_PROGRAMS

config BR2_PACKAGE_COG_PROGRAMS_DBUS_SYSTEM_BUS
	bool "expose remote control interface on system bus"
	help
	  If enabled, the D-Bus remote control interface is exposed
	  on the system bus, instead of the session bus.

config BR2_PACKAGE_COG_PROGRAMS_HOME_URI
	string "home uri"
	default ""
	help
	  Default URI to open when "cog" is launched. If an empty
	  string is used, there is no default and the URI to open
	  must be always specified in the command line.

endif

endif
```

## package/dinghy/Config.in
```kconfig
config BR2_PACKAGE_DINGHY
	bool "dinghy"
	depends on BR2_PACKAGE_HAS_LIBGLES
	depends on BR2_PACKAGE_WPEWEBKIT
	select BR2_PACKAGE_LIBGLIB2
	select BR2_PACKAGE_LIBXKBCOMMON
	select BR2_PACKAGE_WAYLAND
	select BR2_PACKAGE_WPEBACKEND
	select BR2_PACKAGE_WPEBACKEND_FDO
	help
	  Bare-bones WPE full screen browser.
```

## package/eglinfo/Config.in
```kconfig
config BR2_PACKAGE_EGLINFO
	bool "eglinfo"
	depends on BR2_PACKAGE_HAS_LIBEGL
	help
	  Provides information about an EGL implementation.
```

## package/libwpe/Config.in
```kconfig
config BR2_PACKAGE_LIBWPE
	bool "libwpe"
	depends on BR2_INSTALL_LIBSTDCPP
	depends on BR2_PACKAGE_HAS_LIBEGL # uses eglplatform.h
	depends on !BR2_STATIC_LIBS       # uses libdl
	select BR2_PACKAGE_LIBXKBCOMMON
	help
	  Base library for the WPE WebKit port.

	  https://github.com/WebPlatformForEmbedded/libwpe
```

## package/wpebackend-fdo/Config.in
```kconfig
config BR2_PACKAGE_WPEBACKEND_FDO
	bool "wpebackend-fdo"
	depends on BR2_PACKAGE_HAS_LIBEGL
	select BR2_PACKAGE_LIBGLIB2
	select BR2_PACKAGE_LIBWPE
	select BR2_PACKAGE_WAYLAND
	help
	  WPEBackend interface using freedesktop.org APIs
```

## package/wpebackend-rdk/Config.in
```kconfig
config BR2_PACKAGE_WPEBACKEND_RDK
	bool "wpebackend-rdk"
	select BR2_PACKAGE_LIBWPE
	select BR2_PACKAGE_XKEYBOARD_CONFIG if BR2_PACKAGE_LIBXKBCOMMON
	select BR2_PACKAGE_LIBINPUT
	help
	  The RDK backend supports a number of different hardware
	  devices. Currently the Raspberry Pi is the only one
	  supported (using rpi-userland) without using proprietary
	  blobs.
```

## package/wpebackend/Config.in
```kconfig
config BR2_PACKAGE_WPEBACKEND
	bool "wpebackend"
	depends on BR2_PACKAGE_HAS_LIBEGL # uses eglplatform.h
	depends on !BR2_STATIC_LIBS       # uses libdl
	help
	  Base library for the WPE WebKit port.

	  https://github.com/WebPlatformForEmbedded/WPEBackend
```

## package/wpewebkit/Config.in
```kconfig
config BR2_PACKAGE_WPEWEBKIT_ARCH_SUPPORTS
	bool
	# ARM needs BLX, so v5t+, BE completely untested so disabled
	default y if BR2_arm && !BR2_ARM_CPU_ARMV4
	default y if BR2_aarch64
	default y if BR2_i386 || BR2_x86_64
	# Disabled on MIPS big endian due to sigbus
	default y if BR2_mipsel || BR2_mips64el
	# Disabled on PowerPC pending runtime testing
	# Disabled on SuperH because of segfault
	depends on BR2_USE_MMU # libglib2
	depends on BR2_TOOLCHAIN_HAS_SYNC_4
	depends on BR2_PACKAGE_LIBGPG_ERROR_ARCH_SUPPORTS # libgcrypt

comment "wpewebkit needs a glibc toolchain w/ C++, OpenGL backend, gcc >= 6, host gcc >= 4.8"
	depends on BR2_PACKAGE_WPEWEBKIT_ARCH_SUPPORTS
	depends on !BR2_INSTALL_LIBSTDCPP || \
		!BR2_TOOLCHAIN_USES_GLIBC || \
		!BR2_HOST_GCC_AT_LEAST_4_8 || \
		!BR2_TOOLCHAIN_GCC_AT_LEAST_6 || \
		!BR2_PACKAGE_HAS_LIBEGL || \
		!BR2_PACKAGE_HAS_LIBGLES
	depends on BR2_USE_MMU

config BR2_PACKAGE_WPEWEBKIT
	bool "wpewebkit"
	depends on BR2_INSTALL_LIBSTDCPP
	depends on BR2_HOST_GCC_AT_LEAST_4_8 # icu
	depends on BR2_TOOLCHAIN_GCC_AT_LEAST_6
	depends on BR2_TOOLCHAIN_USES_GLIBC
	depends on BR2_PACKAGE_WPEWEBKIT_ARCH_SUPPORTS
	depends on BR2_PACKAGE_HAS_LIBEGL # libepoxy
	select BR2_PACKAGE_CAIRO
	select BR2_PACKAGE_CAIRO_PNG
	select BR2_PACKAGE_HARFBUZZ
	select BR2_PACKAGE_ICU
	select BR2_PACKAGE_JPEG
	select BR2_PACKAGE_LIBEPOXY
	select BR2_PACKAGE_LIBGCRYPT
	select BR2_PACKAGE_LIBPNG
	select BR2_PACKAGE_LIBSOUP
	select BR2_PACKAGE_LIBWPE
	select BR2_PACKAGE_LIBXML2
	select BR2_PACKAGE_SQLITE
	select BR2_PACKAGE_WEBP
	select BR2_PACKAGE_WEBP_DEMUX
	select BR2_PACKAGE_WOFF2
	help
	  WebKit is an open source, standards compliant web browser
	  engine. The WPE port is specifically aimed towards usage in
	  embedded devices.

	  http://wpewebkit.org/

if BR2_PACKAGE_WPEWEBKIT

config BR2_PACKAGE_WPEWEBKIT_MINIBROWSER
	bool "MiniBrowser"
	depends on BR2_PACKAGE_WPEBACKEND_FDO || BR2_PACKAGE_WPEBACKEND_RDK
	help
	  Use MiniBrowser as WPE launcher.

comment "MiniBrowser needs a WPEBackend"
	depends on !BR2_PACKAGE_WPEBACKEND_FDO && !BR2_PACKAGE_WPEBACKEND_RDK

if BR2_PACKAGE_WPEWEBKIT_MINIBROWSER

choice
	prompt "Backend Type"
	default BR2_PACKAGE_WPEWEBKIT_MINIBROWSER_BACKEND_DEFAULT

config BR2_PACKAGE_WPEWEBKIT_MINIBROWSER_BACKEND_DEFAULT
	bool "Default WPE Backend"
	help
	  MiniBrowser will use default WPE backend.

config BR2_PACKAGE_WPEWEBKIT_MINIBROWSER_BACKEND_FDO
	bool "FDO Backend"
	depends on BR2_PACKAGE_WPEBACKEND_FDO && BR2_PACKAGE_WAYLAND && BR2_PACKAGE_MESA3D_OPENGL_EGL
	help
	  MiniBrowser will use FDO backend.

endchoice

comment "FDO backend needs OpenGL implementation like MESA3D which supports WAYLAND EGL "
	depends on !BR2_PACKAGE_MESA3D_OPENGL_EGL

endif

config BR2_PACKAGE_WPEWEBKIT_BUILD_JSC
	bool "build jsc"
	help
	  Builds and install the "jsc" interactive JavaScript shell.

config BR2_PACKAGE_WPEWEBKIT_HTTPS
	bool "HTTPS support"
	default y
	depends on !BR2_STATIC_LIBS # gnutls -> libsoup
	select BR2_PACKAGE_CA_CERTIFICATES # runtime
	select BR2_PACKAGE_LIBSOUP_SSL
	help
	  Enable HTTP protocol support.

comment "wpewebkit https support needs a toolchain w/ dynamic library"
	depends on BR2_STATIC_LIBS

config BR2_PACKAGE_WPEWEBKIT_MULTIMEDIA
	bool "multimedia support"
	select BR2_PACKAGE_GSTREAMER1
	select BR2_PACKAGE_GST1_PLUGINS_BAD
	select BR2_PACKAGE_GST1_PLUGINS_BAD_PLUGIN_GL if BR2_PACKAGE_HAS_LIBEGL || BR2_PACKAGE_HAS_LIBGL
	select BR2_PACKAGE_GST1_PLUGINS_BAD_PLUGIN_MPEGTSDEMUX
	select BR2_PACKAGE_GST1_PLUGINS_BAD_LIB_OPENGL if BR2_PACKAGE_HAS_LIBEGL || BR2_PACKAGE_HAS_LIBGL
	select BR2_PACKAGE_GST1_PLUGINS_BASE
	select BR2_PACKAGE_GST1_PLUGINS_BASE_LIB_OPENGL if BR2_PACKAGE_HAS_LIBGL || BR2_PACKAGE_HAS_LIBGLES
	select BR2_PACKAGE_GST1_PLUGINS_BASE_PLUGIN_ALSA
	select BR2_PACKAGE_GST1_PLUGINS_BASE_PLUGIN_APP
	select BR2_PACKAGE_GST1_PLUGINS_BASE_PLUGIN_AUDIOCONVERT
	select BR2_PACKAGE_GST1_PLUGINS_BASE_PLUGIN_AUDIORESAMPLE
	select BR2_PACKAGE_GST1_PLUGINS_BASE_PLUGIN_PLAYBACK
	select BR2_PACKAGE_GST1_PLUGINS_BASE_PLUGIN_VIDEOCONVERT
	select BR2_PACKAGE_GST1_PLUGINS_BASE_PLUGIN_VIDEOSCALE
	select BR2_PACKAGE_GST1_PLUGINS_BASE_PLUGIN_VOLUME
	select BR2_PACKAGE_GST1_PLUGINS_GOOD
	select BR2_PACKAGE_GST1_PLUGINS_GOOD_PLUGIN_ISOMP4
	select BR2_PACKAGE_GST1_PLUGINS_GOOD_PLUGIN_MATROSKA
	select BR2_PACKAGE_GST1_PLUGINS_GOOD_PLUGIN_RTSP
	select BR2_PACKAGE_GST1_PLUGINS_GOOD_PLUGIN_VPX
	select BR2_PACKAGE_GST1_LIBAV
	help
	  This option pulls in all of the required dependencies
	  to enable multimedia (video/audio) support.

config BR2_PACKAGE_WPEWEBKIT_WEBCRYPTO
	bool "WebCrypto support"
	default y
	select BR2_PACKAGE_LIBTASN1
	help
	  Enable support for the WebCrypto API. This will add libtasn1
	  as a dependency.

config BR2_PACKAGE_WPEWEBKIT_WEBDRIVER
	bool "WebDriver support"
	default y
	help
	  Enable support for WebDriver. This will build and install the
	  WebKitWebDriver program in the target.

config BR2_PACKAGE_WPEWEBKIT_XSLT
	bool "XSLT support"
	default y
	select BR2_PACKAGE_LIBXSLT
	help
	  Enable support for XSLT. This adds libxslt2 as a dependecy.

endif
```
